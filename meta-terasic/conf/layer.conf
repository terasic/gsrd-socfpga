## meta-terasic/conf/machine/comet_a65-gsrd.conf
```bitbake
#@TYPE: Machine
#@NAME: Altera SoCFPGA Agilex5
#@DESCRIPTION: Additional machine configuration for the Agilex5 SoCFPGA

IMAGE_TYPE:comet_a65 ?= "gsrd"

KERNEL_REPO = "git://github.com/terasic/linux-socfpga.git"
KERNEL_PROT = "https"

UBOOT_REPO = "git://github.com/terasic/u-boot-socfpga.git"
UBOOT_PROT = "https"

ATF_REPO = "git://github.com/terasic/arm-trusted-firmware.git"
ATF_PROT = "https"


MACHINE_ESSENTIAL_EXTRA_RRECOMMENDS:append:comet_a65 = " \
		kernel-modules \
		kernel-devicetree \
		"
```

## meta-terasic/conf/machine/comet_a65.conf
```bitbake
#@TYPE: Machine
#@NAME: Terasic Comet A65
#@DESCRIPTION: Unified machine configuration for Terasic Comet A65 (SD Card/eMMC)

require conf/machine/include/socfpga_armv8-2a.inc
require conf/machine/include/ubifs_agilex5.inc

# base configurations
KBUILD_DEFCONFIG ?= "defconfig"
KERNEL_CLASSES:append = " kernel-fitimage"
KERNEL_IMAGETYPE = "Image"
FIT_KERNEL_COMP_ALG = "none"
SERIAL_CONSOLES ?= "115200;ttyS0"

# u-boot common configurations
UBOOT_CONFIG ??= "comet_a65-atf"
UBOOT_CONFIG[comet_a65-atf] = "socfpga_agilex5_comet_a65_defconfig"
UBOOT_BINARY = "u-boot.itb"
UBOOT_SUFFIX = "itb"
UBOOT_ENTRYPOINT = "0x4000000"
UBOOT_LOADADDRESS = "0x4000000"

UBOOT_EXTLINUX ?= "1"
UBOOT_EXTLINUX_LABELS ?= "default"
UBOOT_EXTLINUX_DEFAULT_LABEL ?= "Terasic Comet A65 SDMMC"

UBOOT_EXTLINUX_MENU_DESCRIPTION:default ?= "Terasic Comet A65 SDMMC"
UBOOT_EXTLINUX_KERNEL_IMAGE:default ?= "../${KERNEL_IMAGETYPE}"
UBOOT_EXTLINUX_FDTDIR:default ?= ".."
UBOOT_EXTLINUX_CONSOLE ?= "console=ttyS0,115200n8"
UBOOT_EXTLINUX_KERNEL_ARGS:default ?= "rootwait rw earlyprintk"
UBOOT_EXTLINUX_ROOT:default ?= "root=/dev/mmcblk0p2"


BOOT_MEDIUM ??= "sdmmc"

KERNEL_DEVICETREE = "intel/socfpga_agilex5_comet_a65.dtb \
					intel/socfpga_agilex5_comet_a65_emmc.dtb"


IMAGE_BOOT_FILES = " \
    ${UBOOT_BINARY} \
    Image \
	${@ 'socfpga_agilex5_comet_a65.dtb' if d.getVar('BOOT_MEDIUM') == 'sdmmc' else 'socfpga_agilex5_comet_a65_emmc.dtb;socfpga_agilex5_comet_a65.dtb'} \
	boot.scr.uimg \
"


WKS_FILE ?= "sdimage-stratix10-agilex.wks"
IMAGE_FSTYPES:append = " wic"
```

## meta-terasic/conf/machine/titan_s10_som-gsrd.conf
```bitbake
#@TYPE: Machine
#@NAME: Intel SoCFPGA Stratix10
#@DESCRIPTION: Machine configuration for the Stratix 10 SoCFPGA

IMAGE_TYPE:titan_s10_som ?= "gsrd"

KERNEL_REPO = "git://github.com/terasic/linux-socfpga.git"
KERNEL_PROT = "https"

UBOOT_REPO = "git://github.com/terasic/u-boot-socfpga.git"
UBOOT_PROT = "https"

MACHINE_ESSENTIAL_EXTRA_RRECOMMENDS:append:titan_s10_som = " \
		kernel-modules \
		device-tree \
		hw-ref-design \
		"

EXTRA_IMAGEDEPENDS:append:titan_s10_som = " u-boot-socfpga-scr"

IMAGE_BOOT_FILES:titan_s10_som = " \
		boot.scr.uimg \
		u-boot.itb \
		kernel.itb \
		"
```

## meta-terasic/conf/machine/titan_s10_som.conf
```bitbake
#@TYPE: Machine
#@NAME: Intel SoCFPGA Stratix10
#@DESCRIPTION: Machine configuration for the Stratix 10 SoCFPGA

require conf/machine/include/socfpga_armv8a.inc
require conf/machine/include/ubifs.inc

KBUILD_DEFCONFIG ?= "defconfig"

UBOOT_CONFIG ??= "titan_s10_som-atf"

UBOOT_CONFIG[titan_s10_som-atf] = "socfpga_stratix10_titan_s10_som_defconfig"


UBOOT_BINARY = "u-boot.itb"
UBOOT_SUFFIX = "itb"

KERNEL_CLASSES:append = " kernel-fitimage"
KERNEL_IMAGETYPE = "Image"

KERNEL_DEVICETREE ?= "altera/socfpga_stratix10_titan_s10_som.dtb"
UBOOT_ENTRYPOINT = "0x4000000"
UBOOT_LOADADDRESS = "0x4000000"
FIT_KERNEL_COMP_ALG = "none"

SERIAL_CONSOLES ?= "115200;ttyS0"

EXTRA_IMAGECMD:jffs2 ?= "-n -q -e 0x10000"

UBOOT_EXTLINUX ?= "1"
UBOOT_EXTLINUX_LABELS ?= "default"
UBOOT_EXTLINUX_DEFAULT_LABEL ?= "Terasic Titan S10 SOM SDMMC"

UBOOT_EXTLINUX_MENU_DESCRIPTION:default ?= "Terasic Titan S10 SOM SDMMC"
UBOOT_EXTLINUX_KERNEL_IMAGE:default ?= "../${KERNEL_IMAGETYPE}"
UBOOT_EXTLINUX_FDTDIR:default ?= ".."
UBOOT_EXTLINUX_CONSOLE ?= "console=ttyS0,115200n8"
UBOOT_EXTLINUX_KERNEL_ARGS:default ?= "rootwait rw earlyprintk"
UBOOT_EXTLINUX_ROOT:default ?= "root=/dev/mmcblk0p2"

# Add variables for wic creation of sdcard image
IMAGE_BOOT_FILES ?= " \
			${UBOOT_BINARY} \
			Image \
			socfpga_stratix10_titan_s10_som.dtb \
		    "

WKS_FILE ?= "sdimage-stratix10-agilex.wks"
IMAGE_FSTYPES:append = " wic"
```
